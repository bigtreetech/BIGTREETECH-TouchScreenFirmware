/**
 * Word Keywords Generation
 * Usage: X_WORD(VALUE)
 * 'VALUE' is the keyword name without the 'WORD_'
 *
 * Description: https://en.wikipedia.org/wiki/X_Macro
 *
 * After changing/adding/removing a word, change the LANGUAGE_FLASH_SIGN in Settings.h
 */

// config.ini Parameter Settings - Screen Settings and Feature Settings
X_WORD (LANGUAGE)
X_WORD (EMULATED_M600)
X_WORD (EMULATED_M109_M190)
X_WORD (EVENT_LED)
X_WORD (FILE_COMMENT_PARSING)
X_WORD (ROTATED_UI)
X_WORD (ACK_NOTIFICATION)
X_WORD (FILES_SORT_BY)
X_WORD (FILES_LIST_MODE)
X_WORD (FILENAME_EXTENSION)
X_WORD (FAN_SPEED_PERCENTAGE)
X_WORD (PERSISTENT_INFO)
X_WORD (TERMINAL_ACK)
X_WORD (SERIAL_ALWAYS_ON)
X_WORD (MARLIN_FULLSCREEN)
X_WORD (MARLIN_SHOW_TITLE)
X_WORD (MARLIN_TYPE)
X_WORD (MOVE_SPEED)
X_WORD (AUTO_LOAD_LEVELING)
X_WORD (PROBING_Z_OFFSET)
X_WORD (Z_STEPPERS_ALIGNMENT)
X_WORD (PS_AUTO_SHUTDOWN)
X_WORD (FIL_RUNOUT)
X_WORD (PL_RECOVERY)
X_WORD (PL_RECOVERY_HOME)
X_WORD (BTT_MINI_UPS)
X_WORD (TOUCH_SOUND)
X_WORD (TOAST_SOUND)
X_WORD (ALERT_SOUND)
X_WORD (HEATER_SOUND)
X_WORD (LCD_BRIGHTNESS)
X_WORD (LCD_IDLE_BRIGHTNESS)
X_WORD (LCD_IDLE_TIME)
X_WORD (LCD_LOCK_ON_IDLE)
X_WORD (LED_ALWAYS_ON)
X_WORD (KNOB_LED_COLOR)
X_WORD (KNOB_LED_IDLE)
X_WORD (START_GCODE_ENABLED)
X_WORD (END_GCODE_ENABLED)
X_WORD (CANCEL_GCODE_ENABLED)

// Machine Parameter Settings - Param Title (ordered by gcode)
X_WORD (STEPS_SETTING)        // M92
X_WORD (FILAMENT_SETTING)     // M200
X_WORD (MAXACCELERATION)      // M201
X_WORD (MAXFEEDRATE)          // M203
X_WORD (ACCELERATION)         // M204
X_WORD (JERK)                 // M205
X_WORD (JUNCTION_DEVIATION)   // M205
X_WORD (HOME_OFFSET)          // M206
X_WORD (FWRETRACT)            // M207
X_WORD (FWRECOVER)            // M208
X_WORD (RETRACT_AUTO)         // M209
X_WORD (HOTEND_OFFSET)        // M218
X_WORD (HOTEND_PID)           // M301
X_WORD (BED_PID)              // M304
X_WORD (STEALTH_CHOP)         // M569
X_WORD (DELTA_CONFIGURATION)  // M665
X_WORD (DELTA_TOWER_ANGLE)    // M665
X_WORD (DELTA_DIAGONAL_ROD)   // M665
X_WORD (DELTA_ENDSTOP)        // M666
X_WORD (PROBE_OFFSET)         // M851
X_WORD (LIN_ADVANCE)          // M900
X_WORD (CURRENT_SETTING)      // M906
X_WORD (HYBRID_THRESHOLD)     // M913
X_WORD (BUMP_SENSITIVITY)     // M914
X_WORD (MBL_OFFSET)           // G29

// Machine Parameter Settings - Param Attributes (ordered by gcode)
X_WORD (PRINT_ACCELERATION)     // M204
X_WORD (RETRACT_ACCELERATION)   // M204
X_WORD (TRAVEL_ACCELERATION)    // M204
X_WORD (RETRACT_LENGTH)         // M207
X_WORD (RETRACT_SWAP_LENGTH)    // M207
X_WORD (RETRACT_FEEDRATE)       // M207
X_WORD (RETRACT_Z_LIFT)         // M207
X_WORD (RECOVER_LENGTH)         // M208
X_WORD (SWAP_RECOVER_LENGTH)    // M208
X_WORD (RECOVER_FEEDRATE)       // M208
X_WORD (SWAP_RECOVER_FEEDRATE)  // M208

// Save / Load
X_WORD (SAVE)
X_WORD (RESTORE)
X_WORD (RESET)
X_WORD (EEPROM_SAVE_INFO)
X_WORD (EEPROM_RESTORE_INFO)
X_WORD (EEPROM_RESET_INFO)
X_WORD (SETTINGS_SAVE)
X_WORD (SETTINGS_RESTORE)
X_WORD (SETTINGS_RESET)
X_WORD (SETTINGS_RESET_INFO)
X_WORD (SETTINGS_RESET_DONE)

// Navigation Buttons
X_WORD (PAGE_UP)
X_WORD (PAGE_DOWN)
X_WORD (UP)
X_WORD (DOWN)
X_WORD (NEXT)
X_WORD (BACK)

// Value Buttons
X_WORD (INC)
X_WORD (DEC)
X_WORD (LOAD)
X_WORD (UNLOAD)
X_WORD (ON)
X_WORD (OFF)
X_WORD (AUTO)
X_WORD (SMART)
X_WORD (SLOW)
X_WORD (NORMAL)
X_WORD (FAST)
X_WORD (ZERO)
X_WORD (HALF)
X_WORD (FULL)
X_WORD (CUSTOM)
X_WORD (CLEAR)
X_WORD (DEFAULT)

// Action Buttons
X_WORD (START)
X_WORD (STOP)
X_WORD (PAUSE)
X_WORD (RESUME)
X_WORD (INIT)
X_WORD (DISCONNECT)
X_WORD (SHUT_DOWN)
X_WORD (FORCE_SHUT_DOWN)
X_WORD (EMERGENCYSTOP)
X_WORD (PREHEAT)
X_WORD (PREHEAT_BOTH)
X_WORD (COOLDOWN)

// Dialog Buttons
X_WORD (CONFIRM)
X_WORD (CANCEL)
X_WORD (WARNING)
X_WORD (CONTINUE)
X_WORD (CONFIRMATION)

// Process Status
X_WORD (STATUS)
X_WORD (READY)
X_WORD (BUSY)
X_WORD (LOADING)
X_WORD (UNCONNECTED)
X_WORD (LISTENING)

// Process Info
X_WORD (INFO)
X_WORD (INVALID_VALUE)
X_WORD (TIMEOUT_REACHED)
X_WORD (DISCONNECT_INFO)
X_WORD (SHUTTING_DOWN)
X_WORD (WAIT_TEMP_SHUT_DOWN)
X_WORD (POWER_FAILED)
X_WORD (PROCESS_RUNNING)
X_WORD (PROCESS_COMPLETED)
X_WORD (PROCESS_ABORTED)

// TFT Media, Onboard Media, Filament Runout Process Commands / Status / Info
X_WORD (TFT_SD)
X_WORD (TFT_SD_READ_ERROR)
X_WORD (TFT_SD_INSERTED)
X_WORD (TFT_SD_REMOVED)
X_WORD (TFT_SD_NOT_DETECTED)
X_WORD (TFT_USB)
X_WORD (TFT_USB_READ_ERROR)
X_WORD (TFT_USB_INSERTED)
X_WORD (TFT_USB_REMOVED)
X_WORD (TFT_USB_NOT_DETECTED)
X_WORD (ONBOARD_SD)
X_WORD (ONBOARD_USB)
X_WORD (ONBOARD_SD_READ_ERROR)
X_WORD (FILAMENT_RUNOUT)

// Steppers, Print, Probe Process Commands / Status / Info
X_WORD (DISABLE_STEPPERS)
X_WORD (XY_UNLOCK)

X_WORD (START_PRINT)
X_WORD (STOP_PRINT)
X_WORD (IS_PAUSE)
X_WORD (M0_PAUSE)

X_WORD (TEST)
X_WORD (DEPLOY)
X_WORD (STOW)
X_WORD (REPEAT)
X_WORD (HS_ON)
X_WORD (HS_OFF)

// Printer Tools
X_WORD (NOZZLE)
X_WORD (BED)
X_WORD (CHAMBER)
X_WORD (FAN)

X_WORD (BLTOUCH)
X_WORD (TOUCHMI)

// Values
X_WORD (1_DEGREE)
X_WORD (5_DEGREE)
X_WORD (10_DEGREE)

X_WORD (001_MM)
X_WORD (01_MM)
X_WORD (1_MM)
X_WORD (5_MM)
X_WORD (10_MM)
X_WORD (100_MM)
X_WORD (200_MM)

X_WORD (1_PERCENT)
X_WORD (5_PERCENT)
X_WORD (10_PERCENT)
X_WORD (PERCENT_VALUE)

X_WORD (5_SECONDS)
X_WORD (10_SECONDS)
X_WORD (30_SECONDS)
X_WORD (60_SECONDS)
X_WORD (120_SECONDS)
X_WORD (300_SECONDS)

// Colors
X_WORD (WHITE)
X_WORD (BLACK)
X_WORD (BLUE)
X_WORD (RED)
X_WORD (GREEN)
X_WORD (CYAN)
X_WORD (YELLOW)
X_WORD (BROWN)
X_WORD (GRAY)
X_WORD (ORANGE)
X_WORD (INDIGO)
X_WORD (VIOLET)
X_WORD (MAGENTA)
X_WORD (PURPLE)
X_WORD (LIME)
X_WORD (DARKBLUE)
X_WORD (DARKGREEN)
X_WORD (DARKGRAY)

// Menus
X_WORD (HEAT)
X_WORD (MOVE)
X_WORD (HOME)
X_WORD (PRINT)
X_WORD (EXTRUDE)
X_WORD (SETTINGS)
X_WORD (SCREEN_SETTINGS)
X_WORD (UI_SETTINGS)
X_WORD (SOUND)
X_WORD (MARLIN_MODE_SETTINGS)
X_WORD (MACHINE_SETTINGS)
X_WORD (PARAMETER_SETTINGS)
X_WORD (FEATURE_SETTINGS)
X_WORD (CONNECTION_SETTINGS)
X_WORD (SERIAL_PORTS)
X_WORD (BAUDRATE)
X_WORD (EEPROM_SETTINGS)
X_WORD (RGB_SETTINGS)
X_WORD (RGB_OFF)
X_WORD (TERMINAL)
X_WORD (LEVELING)
X_WORD (POINT_1)
X_WORD (POINT_2)
X_WORD (POINT_3)
X_WORD (POINT_4)
X_WORD (POINT_5)
X_WORD (BED_LEVELING)
X_WORD (BL_COMPLETE)
X_WORD (BL_SMART_FILL)
X_WORD (BL_ENABLE)
X_WORD (BL_DISABLE)
X_WORD (ABL)
X_WORD (BBL)
X_WORD (UBL)
X_WORD (MBL)
X_WORD (MBL_SETTINGS)
X_WORD (ABL_SETTINGS)
X_WORD (ABL_SETTINGS_BBL)
X_WORD (ABL_SETTINGS_UBL)
X_WORD (ABL_SETTINGS_UBL_SAVE)
X_WORD (ABL_SETTINGS_UBL_LOAD)
X_WORD (ABL_SLOT0)
X_WORD (ABL_SLOT1)
X_WORD (ABL_SLOT2)
X_WORD (ABL_SLOT3)
X_WORD (ABL_SLOT_EEPROM)
X_WORD (ABL_Z)
X_WORD (LEVEL_CORNER)
X_WORD (LEVEL_CORNER_INFO)
X_WORD (P_OFFSET)
X_WORD (H_OFFSET)
X_WORD (DISTANCE)
X_WORD (LOAD_UNLOAD)
X_WORD (LOAD_UNLOAD_SHORT)
X_WORD (TOUCHSCREEN_ADJUST)
X_WORD (MORE)
X_WORD (SCREEN_INFO)
X_WORD (BG_COLOR)
X_WORD (FONT_COLOR)
X_WORD (PERCENTAGE)
X_WORD (PERCENTAGE_SPEED)
X_WORD (PERCENTAGE_FLOW)
X_WORD (BABYSTEP)
X_WORD (X_INC)
X_WORD (Y_INC)
X_WORD (Z_INC)
X_WORD (X_DEC)
X_WORD (Y_DEC)
X_WORD (Z_DEC)
X_WORD (X)
X_WORD (Y)
X_WORD (Z)
X_WORD (ADJUST_TITLE)
X_WORD (ADJUST_INFO)
X_WORD (ADJUST_OK)
X_WORD (ADJUST_FAILED)
X_WORD (UNIFIEDMOVE)
X_WORD (UNIFIEDHEAT)
X_WORD (TOUCH_TO_EXIT)
X_WORD (MAINMENU)
X_WORD (LEVELING_EDGE_DISTANCE)
X_WORD (TUNING)
X_WORD (MPC)
X_WORD (MPC_TITLE)
X_WORD (PID)
X_WORD (PID_TITLE)
X_WORD (TUNE_START_INFO)
X_WORD (TUNE_EXTRUDER)
X_WORD (TUNE_EXT_EXTRUDE_100)
X_WORD (TUNE_EXT_TEMP)
X_WORD (TUNE_EXT_MARK120MM)
X_WORD (TUNE_EXT_HEATOFF)
X_WORD (TUNE_EXT_ADJ_ESTEPS)
X_WORD (TUNE_EXT_ESTEPS_SAVED)
X_WORD (TUNE_EXT_MEASURED)
X_WORD (TUNE_EXT_OLD_ESTEP)
X_WORD (TUNE_EXT_NEW_ESTEP)
X_WORD (NOTIFICATIONS)
X_WORD (MESH_EDITOR)
X_WORD (MESH_TUNER)
X_WORD (CASE_LIGHT)
X_WORD (LOAD_STARTED)
X_WORD (UNLOAD_STARTED)
X_WORD (HEATERS_ON)
X_WORD (PRINT_FINISHED)
X_WORD (MAIN_SCREEN)
X_WORD (PREVIOUS_PRINT_DATA)
X_WORD (PRINT_TIME)
X_WORD (FILAMENT_LENGTH)
X_WORD (FILAMENT_WEIGHT)
X_WORD (FILAMENT_COST)
X_WORD (NO_FILAMENT_STATS)
X_WORD (CLICK_FOR_MORE)
X_WORD (EXT_TEMPLOW)
X_WORD (HEAT_HOTEND)
X_WORD (DESIRED_TEMPLOW)
X_WORD (WAIT_HEAT_UP)
X_WORD (Z_ALIGN)
X_WORD (MACROS)
X_WORD (MESH_VALID)
X_WORD (CONNECT_PROBE)
X_WORD (DISCONNECT_PROBE)
X_WORD (CALIBRATION)
// After changing/adding/removing a word, change the LANGUAGE_FLASH_SIGN in Settings.h
