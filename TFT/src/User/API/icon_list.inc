/** //TG MODIFIED*****
* Icon Keywords Generation
* Usage: X_ICON(VALUE)
* 'VALUE' is the keyword name without the 'ICON_'
*
* Description: https://en.wikipedia.org/wiki/X_Macro
*
* After changing/adding/removing an icon, change the ICON_FLASH_SIGN in Settings.h
*/


X_ICON (HEAT)
X_ICON (MOVE)
X_ICON (HOME)
X_ICON (DISABLE_STEPPERS)
X_ICON (PRINT)
//X_ICON (EXTRUDE)		//TG 2/18/21 removed
X_ICON (FAN)
X_ICON (SETTINGS)
X_ICON (LEVELING)
X_ICON (Z_FADE)
X_ICON (INC)
X_ICON (DEC)
//X_ICON (NOZZLE)		//TG 2/18/21 removed
//X_ICON (BED)			//TG 2/18/21 removed
X_ICON (CHAMBER)
//X_ICON (1_DEGREE)     //TG 2/18/21 removed
//X_ICON (5_DEGREE)     //TG 2/18/21 removed
//X_ICON (10_DEGREE)    //TG 2/18/21 removed
X_ICON (APPLY)
X_ICON (STOP)
X_ICON (BACK)
X_ICON (X_INC)
X_ICON (Y_INC)
X_ICON (Z_INC)
X_ICON (01_MM)
X_ICON (1_MM)
X_ICON (10_MM)
X_ICON (100_MM)
X_ICON (X_DEC)
X_ICON (Y_DEC)
X_ICON (Z_DEC)
X_ICON (X_HOME)
X_ICON (Y_HOME)
X_ICON (Z_HOME)
X_ICON (FOLDER)
X_ICON (FILE)
X_ICON (PAGE_UP)
X_ICON (PAGE_DOWN)
X_ICON (PAUSE)
X_ICON (RESUME)
X_ICON (LOAD)
X_ICON (UNLOAD)
X_ICON (SLOW_SPEED)
X_ICON (NORMAL_SPEED)
X_ICON (FAST_SPEED)
//X_ICON (E_1_MM)               //TG removed in CNC version, make room for RPM icons
//X_ICON (E_5_MM)               //TG removed in CNC version, make room for RPM icons
//X_ICON (E_10_MM)              //TG removed in CNC version, make room for RPM icons
//X_ICON (E_100_MM)             //TG removed in CNC version, make room for RPM icons
//X_ICON (E_200_MM)             //TG removed in CNC version, make room for RPM icons
X_ICON (E_1_PERCENT)
X_ICON (E_5_PERCENT)
X_ICON (E_10_PERCENT)
X_ICON (FAN_FULL_SPEED)
X_ICON (FAN_HALF_SPEED)
X_ICON (ROTATE_UI)
X_ICON (LANGUAGE)
X_ICON (TOUCHSCREEN_ADJUST)
X_ICON (MORE)
X_ICON (SCREEN_INFO)
X_ICON (MARLIN_MODE)
X_ICON (DISCONNECT)
X_ICON (BAUD_RATE)
X_ICON (PERCENTAGE)
X_ICON (BABYSTEP)
X_ICON (001_MM)
X_ICON (ONBOARD_SD)
X_ICON (ONTFT_SD)
X_ICON (U_DISK)
X_ICON (POINT_1)
X_ICON (POINT_2)
X_ICON (POINT_3)
X_ICON (POINT_4)
X_ICON (POINT_5)
X_ICON (MARLIN)
X_ICON (BIGTREETECH)
X_ICON (GCODE)
X_ICON (BLTOUCH)
X_ICON (BLTOUCH_DEPLOY)
X_ICON (BLTOUCH_STOW)
X_ICON (BLTOUCH_TEST)
X_ICON (BLTOUCH_REPEAT)
X_ICON (BLTOUCH_RESET)
X_ICON (SCREEN_SETTINGS)
X_ICON (MACHINE_SETTINGS)
X_ICON (FEATURE_SETTINGS)
X_ICON (PROBE_OFFSET)
X_ICON (EEPROM_SAVE)
X_ICON (EEPROM_RESTORE)
X_ICON (EEPROM_RESET)
X_ICON (SOUND)
X_ICON (SHUT_DOWN)
X_ICON (RGB_SETTINGS)
X_ICON (RGB_RED)
X_ICON (RGB_GREEN)
X_ICON (RGB_BLUE)
X_ICON (RGB_WHITE)
X_ICON (RGB_OFF)
X_ICON (PREHEAT_BOTH)
X_ICON (PREHEAT)
X_ICON (CUSTOM)
X_ICON (MANUAL_LEVEL)
X_ICON (PARAMETER)
X_ICON (RESET_VALUE)
X_ICON (GLOBAL_CHAMBER)
X_ICON (GLOBAL_BED)
X_ICON (GLOBAL_NOZZLE)
//X_ICON (PRINTING_NOZZLE)		//TG 2/18/21 removed
//X_ICON (PRINTING_BED)			//TG 2/18/21 removed
X_ICON (PRINTING_FAN)
X_ICON (PRINTING_TIMER)
X_ICON (PRINTING_ZLAYER)
X_ICON (PRINTING_SPEED)
X_ICON (PRINTING_FLOW)
X_ICON (MAINMENU)
X_ICON (HOME_MOVE)
X_ICON (HEAT_FAN)
//X_ICON (COOLDOWN)             //TG 2/18/21 removed
//X_ICON (STATUS_NOZZLE)        //TG 1/14/20 replacing with SPINDLE
//X_ICON (STATUS_BED)           //TG 1/14/20 replacing with VACUUM
X_ICON (STATUS_FAN)
X_ICON (STATUS_SPEED)
X_ICON (STATUS_FLOW)
X_ICON (LEVELING_OFF)
X_ICON (LEVELING_ON)
X_ICON (NOZZLE_DOWN)
X_ICON (NOZZLE_UP)
X_ICON (LEVEL_EDGE_DISTANCE)
X_ICON (TUNING)
X_ICON (PID)
X_ICON (TUNE_EXTRUDER)
X_ICON (CONNECTION_SETTINGS)
X_ICON (CASE_LIGHT)
X_ICON (Z_ALIGN)
X_ICON (MESH_EDITOR)
X_ICON (BRIGHTNESS)
X_ICON (TGMENU)             //TG 1/12/20 new
X_ICON (M503)               //TG 1/12/20 new
X_ICON (GLOBAL_VACUUM)       //TG 1/12/20 new
X_ICON (GLOBAL_SPINDLE)     //TG 1/12/20 new
X_ICON (GLOBAL_LASER)       //TG 1/12/20 new
X_ICON (PRINTING_VACUUM)     //TG 1/12/20 new
X_ICON (PRINTING_SPINDLE)   //TG 1/12/20 new
X_ICON (PRINTING_LASER)     //TG 1/12/20 new
X_ICON (STATUS_VACUUM)       //TG 1/12/20 new
X_ICON (STATUS_SPINDLE)     //TG 1/12/20 new
X_ICON (STATUS_LASER  )     //TG 1/12/20 new
X_ICON (SPINDLE)            //TG 1/12/20 new
X_ICON (VACUUM)              //TG 1/12/20 new
X_ICON (LASER)              //TG 1/12/20 new
X_ICON (LASER_2)            //TG 1/12/20 new
X_ICON (LASER_100)          //TG 1/12/20 new
X_ICON (LASER_OFF)          //TG 1/12/20 new
X_ICON (ZERO_X)             //TG 1/12/20 new
X_ICON (ZERO_Y)             //TG 1/12/20 new
X_ICON (ZERO_Z)             //TG 1/12/20 new
X_ICON (500_RPM)            //TG 2/10/21 new
X_ICON (1000_RPM)           //TG 2/10/21 new
X_ICON (5000_RPM)           //TG 2/10/21 new
X_ICON (10000_RPM)          //TG 2/10/21 new
X_ICON (SSTART)             //TG 2/10/21 new
X_ICON (SSTOP)              //TG 2/10/21 new
X_ICON (AUTO_MODE)          //TG 2/18/21 new
X_ICON (AUTO_ON)            //TG 2/18/21 new
X_ICON (REMOVED)            //TG 2/18/21 new
//X_ICON (Z_0)
//X_ICON (Z_300)
//after changing/adding/removing an icon, change the ICON_FLASH_SIGN in Settings.h
