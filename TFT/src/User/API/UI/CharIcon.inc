/**
 * Char Icons Kewords Generation
 * Usage: X_CHAR(VALUE)
 * 'VALUE' is the keyword name without the 'CHARICON_'
 *
 * Description: https://en.wikipedia.org/wiki/X_Macro
 */
X_CHAR (BLANK)
X_CHAR (NOZZLE)
X_CHAR (BED)
X_CHAR (FAN)
X_CHAR (FOLDER)
X_CHAR (FILE)
X_CHAR (PAGEUP)
X_CHAR (PAGEDOWN)
X_CHAR (BACK)
X_CHAR (LEFT_PART1)
X_CHAR (LEFT_PART2)
X_CHAR (RIGHT_PART1)
X_CHAR (RIGHT_PART2)
X_CHAR (ALERT)
X_CHAR (WARNING)
X_CHAR (ERROR)
X_CHAR (CAUTION)
X_CHAR (INFO)
X_CHAR (HAND)
X_CHAR (WAIT)
X_CHAR (QUESTION)
X_CHAR (PLAY)
X_CHAR (PAUSE)
X_CHAR (STOP)
X_CHAR (EJECT)
X_CHAR (PLAY_ROUND)
X_CHAR (PAUSE_ROUND)
X_CHAR (OK_ROUND)
X_CHAR (CANCEL_ROUND)
X_CHAR (MINUS_ROUND)
X_CHAR (PLUS_ROUND)
X_CHAR (MINUS)
X_CHAR (PLUS)
X_CHAR (OK)
X_CHAR (CANCEL)
X_CHAR (HALT)
X_CHAR (UP_DOWN)
X_CHAR (LEFT_RIGHT)
X_CHAR (POINT_LEFT)
X_CHAR (POINT_RIGHT)
X_CHAR (RETURN)
X_CHAR (REDO)
X_CHAR (UNDO)
X_CHAR (DOWNLOAD)
X_CHAR (UPLOAD)
X_CHAR (BULLET)
X_CHAR (BACK_SMALL)
X_CHAR (EXPAND)
X_CHAR (MOVE)
X_CHAR (ROTATE)
X_CHAR (RESET)
X_CHAR (EDIT)
X_CHAR (SAVE)
X_CHAR (DELETE)
X_CHAR (RADIO_CHECKED)
X_CHAR (RADIO_UNCHECKED)
X_CHAR (CHECKED)
X_CHAR (UNCHECKED)
X_CHAR (SOUND_OFF)
X_CHAR (SOUND_ON)
X_CHAR (ALERT_OFF)
X_CHAR (ALERT_ON)
X_CHAR (POWER_OFF)
X_CHAR (POWER_ON)
X_CHAR (WIFI_OFF)
X_CHAR (WIFI_ON)
X_CHAR (KEYBOARD)
X_CHAR (SD_ERROR)
X_CHAR (SD_OK)
X_CHAR (SD_REFRESH)
X_CHAR (USB_ERROR)
X_CHAR (USB_OK)
X_CHAR (PRINTER_ERROR)
X_CHAR (PRINTER_OK)
X_CHAR (BOARD)
X_CHAR (EEPROM)
X_CHAR (PRINT)
X_CHAR (SETTING1)
X_CHAR (PLUGIN)
X_CHAR (FEATURE)
X_CHAR (SETTING2)
X_CHAR (DETAIL)
X_CHAR (DETAIL2)
X_CHAR (ADJUST)
X_CHAR (MENU)
X_CHAR (POWER)
X_CHAR (TOUCH)
X_CHAR (LANGUAGE)
X_CHAR (CODE)
X_CHAR (POWER_PLUG)
X_CHAR (ROTATE_DEVICE)
X_CHAR (WINDOW)
X_CHAR (BACKGROUND_COLOR)
X_CHAR (FONT_COLOR)
X_CHAR (PAINT)
X_CHAR (TOGGLE_SMALL_ON)
X_CHAR (TOGGLE_SMALL_OFF)
X_CHAR (TOGGLE_BODY)
X_CHAR (TOGGLE_SWITCH)
X_CHAR (TOGGLE_ON)        // only for toggle state detection
X_CHAR (TOGGLE_OFF)       // only for toggle state detection
